## boards/shields/zephyr_zest-security-secureelement/Kconfig.defconfig
```kconfig
if SHIELD_STSAFE_A1XX
    config I2C
        default y

    config LIB_STSELIB
        default y

endif
```

## boards/shields/zest-security-secureelement/Kconfig.shield
```kconfig
# Copyright (c) 2026 CATIE
# SPDX-License-Identifier: Apache-2.0

config SHIELD_ZEST_SECURITY_SECUREELEMENT
	def_bool $(shields_list_contains,zest_security_secureelement)

config SHIELD_ZEST_SECURITY_SECUREELEMENT_INIT_PRIORITY
    int
    default 85
    depends on SHIELD_ZEST_SECURITY_SECUREELEMENT
```
