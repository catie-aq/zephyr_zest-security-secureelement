/*
 * Copyright (c) 2026, CATIE
 * SPDX-License-Identifier: Apache-2.0
 */

#include <zephyr/dt-bindings/gpio/sixtron-header.h>

#define PERIPHERAL_ZEST_SECURITY_SECUREELEMENT_ALT(port) \
    i2c_zest_security_secureelement_##port: &sixtron_connector_##port##_i2c {}; \
    gpio_zest_security_secureelement_##port: &sixtron_connector_##port {};

#define DRIVERS_ZEST_SECURITY_SECUREELEMENT_ALT(port, rst_pin) \
    / { \
        zephyr,user { \
            stsafereset-gpios = <&gpio_zest_security_secureelement_##port rst_pin GPIO_ACTIVE_HIGH>; \
        }; \
    }; \
    &i2c_zest_security_secureelement_##port { \
        status = "okay"; \
        clock-frequency = <I2C_BITRATE_STANDARD>; \
    };

#define ZEST_SECURITY_SECUREELEMENT_ALT(port, rst_pin) \
    PERIPHERAL_ZEST_SECURITY_SECUREELEMENT_ALT(port) \
    DRIVERS_ZEST_SECURITY_SECUREELEMENT_ALT(port, rst_pin)

#define ZEST_SECURITY_SECUREELEMENT(port) \
    ZEST_SECURITY_SECUREELEMENT_ALT(port, DIO1)
